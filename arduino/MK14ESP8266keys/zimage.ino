
void sendFavIcon(){

  Serial.println("Favicon requested");  

  sendFavicon();
  
}


void sendFavicon()
{
  // create a favion: https://www.favicon.cc/
  // convert to hex: http://tomeko.net/online_tools/file_to_hex.php?lang=en or https://www.onlinehexeditor.com/
  // Please note that if PROGMEM variables are not globally defined, 
  // you have to define them locally with static keyword, in order to work with PROGMEM.

  // beer glass from FreeFavicon.com
  const static uint8_t tblFavicon[] PROGMEM = {0x89, 0x50, 0x4E, 0x47, 0x0D, 0x0A, 0x1A, 0x0A, 0x00, 0x00, 0x00, 0x0D, 0x49, 0x48, 0x44, 0x52, 
                                               0x00, 0x00, 0x00, 0x10, 0x00, 0x00, 0x00, 0x10, 0x08, 0x04, 0x00, 0x00, 0x00, 0xB5, 0xFA, 0x37, 
                                               0xEA, 0x00, 0x00, 0x00, 0x02, 0x62, 0x4B, 0x47, 0x44, 0x00, 0xFF, 0x87, 0x8F, 0xCC, 0xBF, 0x00, 
                                               0x00, 0x00, 0x09, 0x70, 0x48, 0x59, 0x73, 0x00, 0x00, 0x00, 0x48, 0x00, 0x00, 0x00, 0x48, 0x00, 
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                                               0xFB, 0x00, 0x00, 0x00, 0x00, 0x49, 0x45, 0x4E, 0x44, 0xAE, 0x42, 0x60, 0x82
                                               };
  
  
  
  // from https://github.com/esp8266/Arduino/blob/master/libraries/ESP8266WebServer/examples/FSBrowser/FSBrowser.ino

  // use HTTP/1.1 Chunked response to avoid building a huge temporary string
  if (!webServer.chunkedResponseModeStart(200, "image/x-icon")) {
    webServer.send(505, F("text/html"), F("HTTP1.1 required"));
    return;
  }
  int arraypos=0;
  char output[64];
  byte onebyte;
  int charnum;
  Serial.print("sizeof(tblFavicon) = ");
  Serial.println(sizeof(tblFavicon));
  // output.reserve(64);
  do {
    //Serial.println("converting array");
    //output="";
    for (charnum=0;charnum<32;charnum++){
        //Serial.println("character " + String(arraypos));
        onebyte = pgm_read_byte_near(tblFavicon + arraypos); 
        output[charnum]=onebyte;
        // need to use pgm_read_byte
        arraypos++;
        if (arraypos > sizeof(tblFavicon) ){
          break;
        }
    }
    Serial.println("sending contents");
    Serial.println(charnum);
    if (charnum>0) {
      webServer.sendContent((const char*) output,charnum);
    }
    if (arraypos >= sizeof(tblFavicon) ){
      break;
    }
  }while (true);
  
 Serial.println("finalizing");

  webServer.chunkedResponseFinalize();
  
  
}
